## drivers/gud/Kconfig
```kconfig
#
# Mobicore Configuration
#
if SOC_S5E8845
source "drivers/gud/gud-s5e8845/Kconfig"
endif
```

## drivers/iommu/samsung/Kconfig
```kconfig
# SPDX-License-Identifier: GPL-2.0-only
config SAMSUNG_IOMMU
	tristate "Samsung IOMMU Support"
	select ARM_DMA_USE_IOMMU
	select IOMMU_DMA
	help
	  Support for IOMMU on Samsung Exynos SoCs.
```

## drivers/leds/samsung/Kconfig
```kconfig
# SPDX-License-Identifier: GPL-2.0-only

config FLED_SAMSUNG_IFPMIC
	tristate "common FLASH LED support"
	depends on I2C
	help
	  If you say yes here you will get support for
	  the common led chip.

config LEDS_S2MF301_FLASH
	tristate "FLASH LED support for the S2MF301"
	depends on (MFD_S2MF301) && I2C
	help
	  If you say yes here you will get support for
	  the LEDS_S2MF301_FLASH led chip.
```

## drivers/misc/samsung/Kconfig
```kconfig
source "drivers/misc/samsung/ifconn/Kconfig"
source "drivers/misc/samsung/muic/Kconfig"
```

## drivers/power/supply/samsung/Kconfig
```kconfig
# SPDX-License-Identifier: GPL-2.0-only
#
# Multifunction miscellaneous devices for samsung pmic
#

config PWR_SAMSUNG_IFPMIC
	tristate "common power device driver support"
	depends on (MFD_S2MF301) && I2C
	help
	 Say Y here to enable support for the common power device drivers.

config CHARGER_S2MF301
	tristate "S2MF301 charger support"
	depends on (MFD_S2MF301) && I2C
	help
	 Say Y here to enable support for the S2MF301 charger
	 S2MF301 incluse pmic, led driver.
	 You have to define MFD_S2MF301

config FUELGAUGE_S2MF301
	tristate "S2MF301 fuelgauge driver"
	depends on (MFD_S2MF301) && I2C
	help
	 say y to include support
	 for s.lsi S2MF301 fuelgauge driver.
	 You have to define MFD_S2MF301

config PM_S2MF301
	tristate "S2MF301 power meter support"
	depends on (MFD_S2MF301) && I2C
	help
	 Say Y here to enable support for the S2MF301 power meter.
	 S2MF301 power meter is dependent on MFD_S2MF301
	 so it needs to be defined.

config TOP_S2MF301
	tristate "S2MF301 top support"
	depends on (MFD_S2MF301) && I2C
	help
	 Say Y here to enable support for the S2MF301 top.

config TOP_S2MF301_SUPPORT_S2MC501
	bool "S2MF301 top supports s2mc501 dc"
	depends on TOP_S2MF301
	help
	 Say Y here to enable support for s2mc501 dc functions

config MANAGER_S2M_CHARGER
	tristate "S2M_CHG_MANAGER battery driver"
	help
	  Say Y here to enable support for S2MXXXX charging manager driver.
	  This charging manager driver supports only the basic functions.

config SYSFS_S2MF301
	tristate "ifpmic sysfs system"
	depends on I2C
	help
	 This driver supports a ifpmic sysfs.
```

## drivers/samsung/Kconfig
```kconfig
#
# Copyright (c) 2010-2020 Samsung Electronics Co., Ltd.
#               http://www.samsung.com/
#
# Licensed under GPLv2

source "drivers/samsung/pm/Kconfig"
source "drivers/samsung/factory/Kconfig"

menuconfig SEC_DEBUG
	tristate "Enable Samsung Debugging features"
	default n

config SEC_BOOTSTAT
	tristate "Enable TN Bootstat logging"
	default n
	help
	  This adds support for Samsung boot-stat
	  To compile this driver as a module, choose M here.

config SEC_KEY_NOTIFIER
	tristate "Enable Samsung key event notifier"
	default n
	help
	  Samsung Key input event notifier

config DRV_SAMSUNG
	tristate "Samsung sec class/sysfs Feature"
	default n
	help
	  Samsung sysfs name 'sec' directory create.  

config SEC_FACTORY
	bool "SAMSUNG Factory build option"
	default n
	select CNSS2_DEBUG	
	select SHOW_ASV
	help
	  Include some codes for Factory binary.
	  This option is enabled by Factory build option.
	  In samsung build script, '-F' enables this option.

config SAMSUNG_PRODUCT_SHIP
	bool "set up for product shipping"
	default n
	help
	  This option is enabled by SHIP build option.
	  In samsung build script, '-s' enables this option.

config SEC_REBOOT
	tristate "Enable Samsung reboot features"
	default n
	help
	  Samsung TN reboot extension Feature. Do additional work when reboot.
```

## drivers/samsung/factory/Kconfig
```kconfig
# SPDX-License-Identifier: GPL-2.0
config SEC_FACTORY_INTERPOSER
	bool "Samsung Factory interposer binary"
	default n
	help
	  Samsung Factory interposer binary.

config SEC_RELOC_GPIO
	tristate "Samsung Legacy-Style Relocated GPIO Interface for Factory Mode"
	default n
	depends on DRV_SAMSUNG
	help
    Samsung Legacy-Style Relocated GPIO Interface for Factory Mode
```

## drivers/samsung/pm/sec_thermistor/Kconfig
```kconfig
#
# Copyright (c) 2010-2021 Samsung Electronics Co., Ltd.
#		http://www.samsung.com/
#
# Licensed under GPLv2
#
config SEC_PM_THERMISTOR
    tristate "SEC Thermistor support"
    depends on SEC_PM && IIO
    default n
    help
      This driver supports SEC Thermistor sensor readinga nd its
      interpretation. This driver uses the industrial I/O subsystem
      and need adc-termperature mapping table for conversion.
```

## drivers/soc/samsung/exynos/Kconfig
```kconfig
# SPDX-License-Identifier: GPL-2.0-only
#
# Samsung SoC drivers
#

config EXYNOS_ACPM
	tristate "ACPM driver support"
	depends on ARCH_EXYNOS
	default n
	help
	Support ACPM for Exynos SoC.

config CAL_IF
	tristate "Exynos Chip Abstraction Layer Interface"
	help
	Support CMU CAL for Exynos SoC.

config EXYNOS_DEBUG_INFO
	bool "Exynos Debug infromation"
	default y
	help
	Support printing Exynos Debug information.

config CMUCAL
	tristate "Exynos CMU Chip Abstraction Layer"
	default y
	depends on CAL_IF
	help
	Support CMUCAL for Exynos SoC.

config CMUCAL_V2
	tristate "Exynos CMU Chip Abstraction Layer"
	depends on CAL_IF
	help
	Support CMUCAL_V2 for Exynos SoC.

config CP_PMUCAL
	tristate "Exynos PMU(for CP) Chip Abstraction Layer"
	default n
	depends on CAL_IF
	help
	Support CP_PMUCAL for Exynos SoC.

config GNSS_PMUCAL
        tristate "Exynos PMU(for GNSS) Chip Abstraction Layer"
        depends on CAL_IF
        help
        Support GNSS_PMUCAL for Exynos SoC.

config CHUB_PMUCAL
        tristate "Exynos PMU(for CHUB) Chip Abstraction Layer"
	default n
        depends on CAL_IF
        help
        Support CHUB_PMUCAL for Exynos SoC.

config CMUCAL_DEBUG
	tristate "CMUCAL Debug Interface"
	default y
	depends on CMUCAL

config CMUCAL_QCH_IGNORE_SUPPORT
	tristate "CMUCAL QCH IGNORE Support"
	default y
	depends on CMUCAL

config PMUCAL
        bool "Exynos PMU Chip Abstraction Layer"
        depends on CAL_IF
        default y
        help
        Support PMUCAL for Exynos SoC.

config PMUCAL_DBG
        tristate "Exynos PMUCAL debugging interface"
        depends on PMUCAL
        help
        Support PMUCAL debugging for Exynos SoC.

config EXYNOS_FLEXPMU_DBG
        tristate "Exynos FLEXPMU debugging interface"
	depends on SOC_S5E9925
	help
	Support FLEXPMU for Exynos SoC.

config PMUCAL_CMU_INIT
		tristate "CMU_INIT in kernel"
	default n
	help
	Support PMUCAL_CMU_INIT for Exynos SoC.

config CMU_EWF
	tristate "exynos early wakeup force enable"
	depends on CAL_IF
	default n
	help
	Support CMUEWF for Exynos SoC.


config ACPM_DVFS
        tristate "Exynos ACPM DVFS manager"
        depends on CAL_IF && CMUCAL
        default n
        help
        Support ACPM DVFS for Exynos SoC.

config EXYNOS_POWER_RAIL_DBG
	tristate "Exynos POWER RAIL minlock debugging interface"
	depends on ACPM_DVFS
	default m
	help
	  Support POWER RAIL STATUS for Exynos SoC.

config EXYNOS_ICM
	tristate "Exynos Isolated CryptoManager driver"
	default n
	help
	  Support Exynos Isolated CryptoManager driver

config EXYNOS_SSP
	tristate "Exynos Samsung Secure Platform"
	default m
	help
	  Support Samsung Secure Platform

config EXYNOS_PMU_IF
	tristate "Exynos PMU controller Interface driver"
	help
	Support PMU register API for Exynos SoC.
	select EXYNOS_PMU_ARM_DRIVERS if ARM && ARCH_EXYNOS

config EXYNOS_WOW
	tristate "Exynos Workload Watcher"
	depends on ARM_EXYNOS_DEVFREQ
	default m
	help
	  Exynos Workload Wather (WoW) driver support

config EXYNOS_CHIPID_V2
	tristate "Exynos Chipid controller driver v2"
	depends on ARCH_EXYNOS
	help
	  Exynos chipid V2 driver.
	  Support newly added soc chipid.

config EXYNOS_CRYPTOMANAGER
	tristate "Exynos Samsung CryptoManager"
	default m
	help
	  Support Exynos Samsung CryptoManager

config EXYNOS_PM_QOS
	tristate "Exynos PM QOS"
	default m
	help
	  Support Exynos PM QOS

config EXYNOS_EL2
	tristate "Exynos EL2 Solution"
	depends on ARCH_EXYNOS
	help
	  Exynos EL2 Solution has implemented Stage 2
	  MMU and IOMMU.

config EXYNOS_HYP
	tristate "Exynos Hypervisor Solution"
	depends on ARCH_EXYNOS
	help
	  Exynos Hypervisor Solution based on pKVM and pKVM module.

config EXYNOS_HYP_MODULE
	tristate "Exynos Hypervisor Module"
	depends on EXYNOS_HYP
	help
	  Exynos Hypervisor pKVM module.

config EXYNOS_S2MPU
        tristate "Exynos Stage 2 Memory Protection Unit(S2MPU)"
	depends on EXYNOS_EL2
        help
          Exynos S2MPU driver to set S2MPU access permission.

config EXYNOS_S2MPU_PD
	bool "Exynos S2MPU PM domain support"
	depends on EXYNOS_S2MPU
	default y
	help
	  Backup and restore S2MPU when PM domains
	  turn on and off.

config EXYNOS_HYP_S2MPU
	tristate "Exynos S2MPU Module for pKVM"
	depends on (EXYNOS_S2MPU && EXYNOS_HYP_MODULE)
	help
	  Exynos S2MPU module driver for protected KVM.

config EXYNOS_MCINFO
        tristate "Exynos memory controller information"
        default m

config MCINFO_SYSFS
        bool "Exynos memory controller information sysfs"
        depends on EXYNOS_MCINFO
        default y if SYSFS

source "drivers/soc/samsung/exynos/acpm/Kconfig"
source "drivers/soc/samsung/exynos/debug/Kconfig"
source "drivers/soc/samsung/exynos/dm/Kconfig"
source "drivers/soc/samsung/exynos/cpif/Kconfig"
source "drivers/soc/samsung/exynos/ect_parser/Kconfig"
source "drivers/soc/samsung/exynos/esca_v2/Kconfig"
source "drivers/soc/samsung/exynos/exynos-pd/Kconfig"
source "drivers/soc/samsung/exynos/exynos-pm/Kconfig"
source "drivers/soc/samsung/exynos/gnssif/Kconfig"
source "drivers/soc/samsung/exynos/gnssif_spi/Kconfig"
source "drivers/soc/samsung/exynos/profiler/Kconfig"
```

## drivers/soc/samsung/exynos/dm/Kconfig
```kconfig
# SPDX-License-Identifier: GPL-2.0
#

config EXYNOS_DVFS_MANAGER
	tristate "Exynos DVFS Manager"
	help
	  Enable DVFS Manager for Exynos SoC.
	  This module controls constraint between each DVFS domains.

config EXYNOS_ESCA_DVFS_MANAGER
	tristate "Exynos ESCA DVFS Manager"
	help
	  Enable ESCA DVFS Manager for Exynos SoC.
	  This module controls constraint between each DVFS domains.
```

## drivers/soc/samsung/exynos/ect_parser/Kconfig
```kconfig
# SPDX-License-Identifier: GPL-2.0
#

config ECT
	tristate "Enable Exynos Characteristic Table File"
	default n
	help
	Support ECT for Exynos SoC.
```

## drivers/soc/samsung/exynos/exynos-pd/Kconfig
```kconfig
# SPDX-License-Identifier: GPL-2.0
#

config EXYNOS_PD
	tristate "Exynos PM domain Support"
        depends on CAL_IF && CMUCAL
	depends on PM
	select PM_GENERIC_DOMAINS

config EXYNOS_PD_DBG
	tristate "Exynos PM domain Support"
        depends on CAL_IF && CMUCAL
	depends on PM
	select PM_GENERIC_DOMAINS

config EXYNOS_PD_EL3
	tristate "Exynos PD Save/Restore"
	default m
	help
	Support Exynos Power Domain Save/Restore
```

## drivers/soc/samsung/exynos/exynos-pm/Kconfig
```kconfig
# SPDX-License-Identifier: GPL-2.0
#

config EXYNOS_PM
	tristate "Enable Exynos PM"
	help
	Support EXYNOS_PM for Exynos SoC.

config EXYNOS_S2I
	tristate "Enable Exynos Suspend to IDLE"
	help
	Support EXYNOS_S2I for Exynos SoC.
```

## sound/soc/samsung/exynos/Kconfig
```kconfig
# SPDX-License-Identifier: GPL-2.0
config SND_SOC_SAMSUNG_DISPLAYPORT
	tristate "Samsung DISPLAYPORT Audio"
	help
	  Say Y if you want to use displayport audio.

config SND_SOC_SAMSUNG_EXYNOS8825_S5M3700X_I2C
	tristate "S5M3700X support on exynos8825 with i2c bus"
	select SND_SOC_S5M3700X
	select SND_SOC_S5M3700X_DUMP
	select SND_SOC_S5M3700X_VTS
	select SND_SOC_S5M3700X_HIFI

config SND_SOC_SAMSUNG_EXYNOS_TFA9874
	tristate "TFA9874 amp support on exynos"
	select SND_SOC_TFA9874
	select FW_LOADER_USER_HELPER
	select FW_LOADER_USER_HELPER_FALLBACK

config SND_SOC_SAMSUNG_EXYNOS_TAS25XX
	tristate "TAS25XX amp support on exynos"
	select SND_SOC_TAS25XX
	select TAS25XX_ALGO
	select TAS25XX_CALIB_VAL_BIG
	select SEC_SND_SYNCHRONIZED_IPC_TI
	select PLATFORM_EXYNOS

config SND_SOC_SAMSUNG_EXYNOS_TFA9878
	tristate "TFA9878 amp support on exynos"
	select SND_SOC_TFA98XX
	select SND_SOC_TFA9878
	select FW_LOADER_USER_HELPER
	select SEC_SND_SYNCHRONIZED_IPC

config SND_SOC_SAMSUNG_EXYNOS8845_SOUND
       tristate "Sound card support on exynos8845"
       select SND_SOC_SAMSUNG_ABOX
       select SND_SOC_SAMSUNG_VTS
       select SND_SOC_SAMSUNG_MAILBOX
       select SND_SOC_SAMSUNG_SLIF
#       select SND_SOC_SAMSUNG_DISPLAYPORT

config SND_SOC_SAMSUNG_EXYNOS8845_AUDIO
        tristate "Sound card support on exynos8845"
        select SND_SOC_SAMSUNG_ABOX
        select SND_SOC_SAMSUNG_VTS
        select SND_SOC_SAMSUNG_MAILBOX
        select SND_SOC_SAMSUNG_SLIF
#       select SND_SOC_SAMSUNG_DISPLAYPORT

config SND_SOC_SAMSUNG_AUDIO
	tristate "Audio support for Samsung Projects"
	help
	  Say Y here to enable audio support for the Samsung Audio.

source "sound/soc/samsung/exynos/abox/Kconfig"
source "sound/soc/samsung/exynos/vts/Kconfig"
source "sound/soc/samsung/exynos/slif/Kconfig"
```
